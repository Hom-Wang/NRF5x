/*====================================================================================================*/
/*====================================================================================================*/
#include <stdio.h>

#include "drivers\nrf51_system.h"
#include "drivers\nrf51_uart.h"
#include "module_rs232.h"
/*====================================================================================================*/
/*====================================================================================================*/
#define UARTx               NRF_UART0
#define UARTx_IRQ           UART0_IRQn

#define UARTx_TXD_PIN       9
#define UARTx_RXD_PIN       11

#define UARTx_BAUDRATE      UART_BAUDRATE_BAUDRATE_Baud115200
#define UARTx_PARITY        UART_CONFIG_PARITY_Excluded
#define UARTx_HARDWARECTRL  UART_CONFIG_HWFC_Disabled
/*====================================================================================================*/
/*====================================================================================================*
**函數 : RS232_Config
**功能 : RS232 配置
**輸入 : None
**輸出 : None
**使用 : RS232_Config();
**====================================================================================================*/
/*====================================================================================================*/
void RS232_Config( void )
{
  UART_InitTypeDef UART_InitStruct;

  UART_InitStruct.UART_PinTXD              = UARTx_TXD_PIN;
  UART_InitStruct.UART_PinRXD              = UARTx_RXD_PIN;
  UART_InitStruct.UART_BaudRate            = UARTx_BAUDRATE;
  UART_InitStruct.UART_Parity              = UARTx_PARITY;
  UART_InitStruct.UART_HardwareFlowControl = UARTx_HARDWARECTRL;
  UART_Init(UARTx, &UART_InitStruct);

  UART_InterruptCmd(UARTx, ENABLE);
  NVIC_SetPriority(UARTx_IRQ, 1);
  NVIC_EnableIRQ(UARTx_IRQ);
}
/*====================================================================================================*/
/*====================================================================================================*
**函數 : RS232_SendByte
**功能 : 發送 1Byte 資料
**輸入 : SendByte
**輸出 : None
**使用 : RS232_SendByte('A');
**====================================================================================================*/
/*====================================================================================================*/
void RS232_SendByte( uint8_t SendByte )
{
  UART_SendByte(UARTx, &SendByte);
}
/*====================================================================================================*/
/*====================================================================================================*
**函數 : RS232_SendData
**功能 : 發送資料
**輸入 : *SendData, DataLen
**輸出 : None
**使用 : RS232_SendData(SendData, DataLen);
**====================================================================================================*/
/*====================================================================================================*/
void RS232_SendData( uint8_t *SendData, uint16_t DataLen )
{
  UART_SendData(UARTx, SendData, DataLen);
}
/*====================================================================================================*/
/*====================================================================================================*
**函數 : RS232_SendStr
**功能 : 發送字串
**輸入 : *pWord
**輸出 : None
**使用 : RS232_SendStr("Hellow World!");
**====================================================================================================*/
/*====================================================================================================*/
void RS232_SendStr( char *pWord )
{
  while(*pWord != '\0') {
    UART_SendByte(UARTx, (uint8_t*)pWord++);
  }
}
/*====================================================================================================*/
/*====================================================================================================*
**函數 : RS232_SendNum
**功能 : 將數值轉字串發送
**輸入 : Type, NumLen, SendData
**輸出 : None
**使用 : RS232_SendNum(Type_D, 6, 1024);
**====================================================================================================*/
/*====================================================================================================*/
void RS232_SendNum( StrType Type, uint8_t NumLen, int32_t SendData )
{
  char TrData[32] = {0};
  char *pWord = TrData;

  Str_NumToChar(Type, NumLen, TrData, SendData);

  while(*pWord != '\0') {
    UART_SendByte(UARTx, (uint8_t*)pWord++);
  }
}
/*====================================================================================================*/
/*====================================================================================================*
**函數 : RS232_RecvByte
**功能 : 接收 1Byte 資料
**輸入 : *RecvData
**輸出 : None
**使用 : RecvByte = RS232_RecvByte();
**====================================================================================================*/
/*====================================================================================================*/
int8_t RS232_RecvByte( void )
{
  uint8_t RecvByte = 0;
  UART_RecvByte(UARTx, &RecvByte);
  return RecvByte;
}
/*====================================================================================================*/
/*====================================================================================================*
**函數 : RS232_RecvData
**功能 : 接收資料
**輸入 : *RecvData, DataLen
**輸出 : None
**使用 : RS232_RecvData(RecvData, DataLen);
**====================================================================================================*/
/*====================================================================================================*/
void RS232_RecvData( uint8_t *RecvData, uint16_t DataLen )
{
  UART_RecvData(UARTx, RecvData, DataLen);
}
/*====================================================================================================*/
/*====================================================================================================*
**函數 : RS232_RecvDataWTO
**功能 : 接收資料
**輸入 : *RecvData, DataLen, Timeout_ms
**輸出 : State
**使用 : State = RS232_RecvDataWTO(RecvData, DataLen, Timeout_ms);
**====================================================================================================*/
/*====================================================================================================*/
int8_t RS232_RecvDataWTO( uint8_t *RecvData, uint16_t DataLen, int32_t Timeout_ms )
{
  return UART_RecvDataWTO(UARTx, RecvData, DataLen, Timeout_ms);
}
/*====================================================================================================*/
/*====================================================================================================*
**函數 : RS232_RecvStr
**功能 : 接收字串
**輸入 : *pWord
**輸出 : None
**使用 : RS232_RecvStr(RecvStirng);
**====================================================================================================*/
/*====================================================================================================*/
void RS232_RecvStr( char *pWord )
{
  do {
    UART_RecvByte(UARTx, (uint8_t*)pWord++);
  } while(*(pWord-1) != '\0');
  *pWord = '\0';
}
/*====================================================================================================*/
/*====================================================================================================*
**函數 : RS232_RecvStrWTO
**功能 : 接收字串, 並加入 Timeout 功能
**輸入 : *pWord, TimeoutMs
**輸出 : State
**使用 : RS232_RecvStrWTO(RecvStirng, 200);
**====================================================================================================*/
/*====================================================================================================*/
int8_t RS232_RecvStrWTO( char *pWord, int32_t TimeoutMs )
{
  int8_t State = ERROR;

  do {
    State = UART_RecvByteWTO(UARTx, (uint8_t*)pWord++, TimeoutMs);
    if(State == ERROR)
      return ERROR;
  } while(*(pWord-1) != '\0');
  *pWord = '\0';

  return SUCCESS;
}
/*====================================================================================================*/
/*====================================================================================================*/
int fputc( int ch, FILE *f )
{
  UARTx->TXD = (uint8_t)ch;
  while(UARTx->EVENTS_TXDRDY != 1);
  UARTx->EVENTS_TXDRDY = 0;
  return ch;
}
int fgetc( FILE *f )
{
  while(UARTx->EVENTS_RXDRDY != 1);
  UARTx->EVENTS_RXDRDY = 0;
  return (uint8_t)UARTx->RXD;
}
/*====================================================================================================*/
/*====================================================================================================*/
