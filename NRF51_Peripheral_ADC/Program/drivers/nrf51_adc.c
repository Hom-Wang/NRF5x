/*=====================================================================================================*/
/*=====================================================================================================*/
#include "nrf51_system.h"
#include "nrf51_adc.h"
/*====================================================================================================*/
/*====================================================================================================*
**函數 : ADC_Init
**功能 : ADC Init
**輸入 : ADC_InitStruct
**輸出 : None
**使用 : ADC_Init(ADCx, &ADC_InitStruct);
**====================================================================================================*/
/*====================================================================================================*/
void ADC_Init( NRF_ADC_Type *ADCx, ADC_InitTypeDef *ADC_InitStruct )
{
  ADCx->CONFIG = (ADC_InitStruct->Resolution      << ADC_CONFIG_RES_Pos) | 
                 (ADC_InitStruct->AnalogInput     << ADC_CONFIG_PSEL_Pos) | 
                 (ADC_InitStruct->ConfigReference << ADC_CONFIG_REFSEL_Pos) |
                 (ADC_InitStruct->InputSelection  << ADC_CONFIG_INPSEL_Pos);
}
/*====================================================================================================*/
/*====================================================================================================*
**函數 : ADC_Cmd
**功能 : Enable / Disable ADC
**輸入 : state
**輸出 : None
**使用 : ADC_Cmd(ADCx, ENABLE);
**====================================================================================================*/
/*====================================================================================================*/
void ADC_Cmd( NRF_ADC_Type *ADCx, uint8_t state )
{
  if(state == ENABLE)
    ADCx->ENABLE = (ADC_ENABLE_ENABLE_Enabled  << ADC_ENABLE_ENABLE_Pos);
  else
    ADCx->ENABLE = (ADC_ENABLE_ENABLE_Disabled << ADC_ENABLE_ENABLE_Pos);
}
/*====================================================================================================*/
/*====================================================================================================*
**函數 : ADC_IntCmd
**功能 : Enable / Disable ADC Interrupt
**輸入 : state
**輸出 : None
**使用 : ADC_IntCmd(ADCx, ENABLE);
**====================================================================================================*/
/*====================================================================================================*/
void ADC_IntCmd( NRF_ADC_Type *ADCx, uint8_t state )
{
  if(state == ENABLE)
    ADCx->INTENSET = (ADC_INTENSET_END_Enabled << ADC_INTENSET_END_Pos);
  else
    ADCx->INTENCLR = (ADC_INTENCLR_END_Enabled << ADC_INTENCLR_END_Pos);
}
/*====================================================================================================*/
/*====================================================================================================*
**函數 : ADC_StartConv
**功能 : ADC Start Conversion
**輸入 : None
**輸出 : None
**使用 : ADC_StartConv(ADCx);
**====================================================================================================*/
/*====================================================================================================*/
void ADC_StartConv( NRF_ADC_Type *ADCx )
{
  ADCx->TASKS_START = 1;
}
/*====================================================================================================*/
/*====================================================================================================*
**函數 : ADC_StopConv
**功能 : ADC Stop Conversion
**輸入 : None
**輸出 : None
**使用 : ADC_StopConv(ADCx);
**====================================================================================================*/
/*====================================================================================================*/
void ADC_StopConv( NRF_ADC_Type *ADCx )
{
  ADCx->TASKS_STOP = 1;
}
/*====================================================================================================*/
/*====================================================================================================*
**函數 : ADC_Busy
**功能 : ADC State
**輸入 : None
**輸出 : state
**使用 : state = ADC_Busy(ADCx);
**====================================================================================================*/
/*====================================================================================================*/
uint8_t ADC_Busy( NRF_ADC_Type *ADCx )
{
  if(ADCx->BUSY == 0)
    return SUCCESS;   // Ready
  else
    return ERROR;     // Busy
}
/*====================================================================================================*/
/*====================================================================================================*
**函數 : ADC_EvenCheck
**功能 : ADC Check Even
**輸入 : None
**輸出 : State
**使用 : State = ADC_EvenCheck(ADCx);
**====================================================================================================*/
/*====================================================================================================*/
uint8_t ADC_EvenCheck( NRF_ADC_Type *ADCx )
{
  if(ADCx->EVENTS_END == 1)
    return SUCCESS;
  else
    return ERROR;
}
/*====================================================================================================*/
/*====================================================================================================*
**函數 : ADC_EvenClear
**功能 : ADC Clear Even
**輸入 : None
**輸出 : None
**使用 : ADC_EvenClear();
**====================================================================================================*/
/*====================================================================================================*/
void ADC_EvenClear( NRF_ADC_Type *ADCx )
{
  ADCx->EVENTS_END = 0;
}
/*====================================================================================================*/
/*====================================================================================================*
**函數 : ADC_GetResult
**功能 : Get Result
**輸入 : None
**輸出 : ReadADC
**使用 : ReadADC = ADC_GetResult();
**====================================================================================================*/
/*====================================================================================================*/
uint16_t ADC_GetResult( NRF_ADC_Type *ADCx )
{
  return ADCx->RESULT;
}
/*====================================================================================================*/
/*====================================================================================================*
**函數 : ADC_ReadData
**功能 : Read Data
**輸入 : None
**輸出 : readADC
**使用 : readADC = ADC_ReadData(ADCx);
**====================================================================================================*/
/*====================================================================================================*/
uint16_t ADC_ReadData( NRF_ADC_Type *ADCx )
{
  uint16_t readData = 0;

  ADC_StartConv(ADCx);

  while(ADC_EvenCheck(ADCx) != SUCCESS);
  ADC_EvenClear(ADCx);

	readData = ADC_GetResult(ADCx);

  ADC_StopConv(ADCx);
  
  return readData;
}
/*=====================================================================================================*/
/*=====================================================================================================*/

