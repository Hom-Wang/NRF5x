/*====================================================================================================*/
/*====================================================================================================*/
#include "nrf51_system.h"
#include "nrf51_uart.h"
#include "module_rs232.h"
/*====================================================================================================*/
/*====================================================================================================*/
#define UARTx_TXD_PIN       8
#define UARTx_RXD_PIN       9
#define UARTx_RTS_PIN       0
#define UARTx_CTS_PIN       0

#define UARTx_BAUDRATE      UART_BAUDRATE_BAUDRATE_Baud115200
#define UARTx_PARITY        UART_CONFIG_PARITY_Excluded
#define UARTx_HARDWARECTRL  UART_CONFIG_HWFC_Disabled
/*====================================================================================================*/
/*====================================================================================================*
**函數 : RS232_Config
**功能 : RS232 配置
**輸入 : None
**輸出 : None
**使用 : RS232_Config();
**====================================================================================================*/
/*====================================================================================================*/
void RS232_Config( void )
{
  UART_InitTypeDef UART_InitStruct;

  UART_InitStruct.UART_PinTXD               = UARTx_TXD_PIN;
  UART_InitStruct.UART_PinRXD               = UARTx_RXD_PIN;
  UART_InitStruct.UART_PinRTS               = UARTx_RTS_PIN;
  UART_InitStruct.UART_PinCTS               = UARTx_CTS_PIN;
  UART_InitStruct.UART_BaudRate             = UARTx_BAUDRATE;
  UART_InitStruct.UART_Parity               = UARTx_PARITY;
  UART_InitStruct.UART_HardwareFlowControl  = UARTx_HARDWARECTRL;
  UART_Init(&UART_InitStruct);
}
/*====================================================================================================*/
/*====================================================================================================*
**函數 : RS232_SendByte
**功能 : 發送 1Byte 資料
**輸入 : SendByte
**輸出 : None
**使用 : RS232_SendByte('A');
**====================================================================================================*/
/*====================================================================================================*/
void RS232_SendByte( u8 SendByte )
{
  UART_SendByte(SendByte);
}
/*====================================================================================================*/
/*====================================================================================================*
**函數 : RS232_SendData
**功能 : 發送資料
**輸入 : *SendData, DataLen
**輸出 : None
**使用 : RS232_SendData(SendData, DataLen);
**====================================================================================================*/
/*====================================================================================================*/
void RS232_SendData( u8 *SendData, u16 DataLen )
{
  UART_SendData(SendData, DataLen);
}
/*====================================================================================================*/
/*====================================================================================================*
**函數 : RS232_SendNum
**功能 : 將數值轉字串發送
**輸入 : Type, NumLen, SendData
**輸出 : None
**使用 : RS232_SendNum(Type_O, 6, 1024);
**====================================================================================================*/
/*====================================================================================================*/
void RS232_SendNum( StrType Type, u8 NumLen, s32 SendData )
{
  u8 TrData[32] = {0};
  u8 *pWord = TrData;

  Str_NumToChar(Type, NumLen, TrData, SendData);

  while(*pWord != '\0') {
    UART_SendByte(*pWord);
    pWord++;
  }
}
/*====================================================================================================*/
/*====================================================================================================*
**函數 : RS232_SendStr
**功能 : 發送字串
**輸入 : *pWord
**輸出 : None
**使用 : RS232_SendStr((u8*)"Hellow World!");
**====================================================================================================*/
/*====================================================================================================*/
void RS232_SendStr( u8 *pWord )
{
  while(*pWord != '\0') {
    UART_SendByte(*pWord);
    pWord++;
  }
}
/*====================================================================================================*/
/*====================================================================================================*
**函數 : RS232_RecvByte
**功能 : 接收 1Byte 資料
**輸入 : *RecvData
**輸出 : None
**使用 : RS232_RecvByte(RecvData);
**====================================================================================================*/
/*====================================================================================================*/
void RS232_RecvByte( u8 *RecvData )
{
  *RecvData = UART_RecvByte();
}
/*====================================================================================================*/
/*====================================================================================================*
**函數 : RS232_RecvByteWTO
**功能 : 接收資料
**輸入 : *RecvData
**輸出 : Statea
**使用 : State = RS232_RecvByteWTO(RecvData, Timeout_ms);
**====================================================================================================*/
/*====================================================================================================*/
u8 RS232_RecvByteWTO( u8 *RecvData, s32 Timeout_ms )
{
  return UART_RecvByteWTO(RecvData, Timeout_ms);
}
/*====================================================================================================*/
/*====================================================================================================*
**函數 : RS232_RecvData
**功能 : 接收資料
**輸入 : *RecvData, DataLen
**輸出 : None
**使用 : RS232_RecvData(RecvData, DataLen);
**====================================================================================================*/
/*====================================================================================================*/
void RS232_RecvData( u8 *RecvData, u16 DataLen )
{
  UART_RecvData(RecvData, DataLen);
}
/*====================================================================================================*/
/*====================================================================================================*
**函數 : RS232_RecvDataWTO
**功能 : 接收資料
**輸入 : *RecvData, DataLen, Timeout_ms
**輸出 : State
**使用 : State = RS232_RecvDataWTO(RecvData, DataLen, Timeout_ms);
**====================================================================================================*/
/*====================================================================================================*/
u8 RS232_RecvDataWTO( u8 *RecvData, u16 DataLen, s32 Timeout_ms )
{
  return UART_RecvDataWTO(RecvData, DataLen, Timeout_ms);
}
/*====================================================================================================*/
/*====================================================================================================*
**函數 : RS232_RecvStr
**功能 : 接收字串
**輸入 : *pWord
**輸出 : None
**使用 : RS232_RecvStr(RecvStirng);
**====================================================================================================*/
/*====================================================================================================*/
void RS232_RecvStr( u8 *pWord )
{
  do {
    *pWord = UART_RecvByte();
    pWord++;
  } while(*(pWord-1) != '\0');
  *pWord = '\0';
}
/*====================================================================================================*/
/*====================================================================================================*/
